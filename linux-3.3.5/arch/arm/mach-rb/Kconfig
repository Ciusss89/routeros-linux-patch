## linux-3.3.5/arch/arm/mach-rb/Kconfig
```kconfig
config ARCH_IPQ806X
	bool "IPQ806X support"
	select ARCH_MSM
	select HAVE_CLK
	select GENERIC_CLOCKEVENTS
	select ARCH_REQUIRE_GPIOLIB
	select ARCH_HAS_CPUFREQ
	select CLKDEV_LOOKUP
	select MSM_SMP
	select MSM_BUS_SCALING
	select ARCH_MSM_KRAIT
	select HAVE_SCHED_CLOCK
	select MACH_IPQ806X_RB3011
	select LEDS_GPIO_REGISTER
	select HAVE_CLK_PREPARE
	select SWP_EMULATE
	select ARM_GIC
	select CPU_V7
	select PM
	select PCI
	select PCI_MSI
        select ARCH_SUPPORTS_MSI
	select MSM_PCIE
	select MSM_ADM3
	select MSM_V2_TLMM
	select MSM_GPIOMUX
	select MSM_RPM
	select USB_EHCI_MSM
	select MSM_SCM if SMP
	select QCOM_SCM if SMP
	select HAVE_SMP
	select SMP
	help
	  Support for Qualcomm's ipq806x.

if ARCH_IPQ806X

menu "IPQ806X Options"

config MSM_PCIE
	bool "MSM PCIe Controller driver"
	depends on PCI && PCI_MSI
	help
	  Enables the PCIe functionality by configures PCIe core on
	  MSM chipset and by enabling the ARM PCI framework extension.

config MSM_RPM
	bool "Resource Power Manager"
	select MSM_MPM

config MSM_BUS_SCALING
	bool "Bus scaling driver"
	default n

config CPU_FREQ_MSM
        bool
        depends on CPU_FREQ && ARCH_MSM
        default y
        help
          This enables the CPUFreq driver for Qualcomm CPUs.
          If in doubt, say Y.

endmenu

config MSM_MPM
	bool

config MSM_GPIOMUX
	bool

config MSM_V2_TLMM
	bool

config MSM_ADM3
	bool

config MSM_SCM
	bool

config ARCH_MSM
	bool

config ARCH_MSM_KRAIT
	bool

config MSM_SMP
	bool

endif
```

## linux-3.3.5_patched_3_2_2017/arch/arm/mach-msm/Kconfig
```kconfig
choice
	prompt "Qualcomm MSM SoC Type"

config ARCH_IPQ806X
	bool "IPQ806X"
	select MSM_SMP
	select MSM_BUS_SCALING
	select ARCH_MSM_KRAIT
	select HAVE_SCHED_CLOCK
	select MACH_IPQ806X_RB3011
	select LEDS_GPIO_REGISTER
	select HAVE_CLK_PREPARE
	select SWP_EMULATE
	select ARM_GIC
	select CPU_V7
	select PM
	select PCI
	select PCI_MSI
        select ARCH_SUPPORTS_MSI
	select MSM_PCIE
	select MSM_ADM3
	select MSM_V2_TLMM
	select MSM_GPIOMUX
	select MSM_RPM
	select USB_EHCI_MSM
	select MSM_SCM if SMP
	select HAVE_SMP
	select SMP
	select QCOM_SCM

endchoice

if ARCH_MSM

menu "Qualcomm MSM Board Type"

config MACH_IPQ806X_RB3011
	depends on ARCH_IPQ806X
	bool "IPQ806X RB3011"
	help
	  Support for the Mikrotik IPQ806X RB3011 device.

config MSM_PCIE
	bool "MSM PCIe Controller driver"
	depends on PCI && PCI_MSI
	help
	  Enables the PCIe functionality by configures PCIe core on
	  MSM chipset and by enabling the ARM PCI framework extension.

config MSM_RPM
	bool "Resource Power Manager"
	select MSM_MPM

config MSM_BUS_SCALING
	bool "Bus scaling driver"
	default n

config MSM_NUM_PCIE
	int "Number of PCIe Root Complex"
	default 0 if !MSM_PCIE
	default 3 if ARCH_IPQ806X
	default 1
	range 0 3
	help
	  Max. number of PCIe RCs available in the SoC

config CPU_FREQ_MSM
        bool
        depends on CPU_FREQ && ARCH_MSM
        default y
	help
          This enables the CPUFreq driver for Qualcomm CPUs.
          If in doubt, say Y.

endmenu

config MSM_MPM
	bool

config MSM_GPIOMUX
	bool

config MSM_V2_TLMM
	bool

config MSM_ADM3
	bool

config MSM_SCM
	bool

config ARCH_MSM_KRAIT
	bool

config MSM_SMP
	bool

endif
```

## linux-3.3.5_patched_9_2_2016/arch/arm/mach-msm/Kconfig
```kconfig
if ARCH_MSM

choice
	prompt "Qualcomm MSM SoC Type"
	default ARCH_MSM7X00A

config ARCH_MSM7X00A
	bool "MSM7x00A / MSM7x01A"
	select MACH_TROUT if !MACH_HALIBUT
	select ARCH_MSM_ARM11
	select MSM_SMD
	select MSM_SMD_PKG3
	select CPU_V6
	select GPIO_MSM_V1
	select MSM_PROC_COMM

config ARCH_MSM7X30
	bool "MSM7x30"
	select MACH_MSM7X30_SURF # if !
	select ARCH_MSM_SCORPION
	select MSM_SMD
	select MSM_VIC
	select CPU_V7
	select MSM_GPIOMUX
	select GPIO_MSM_V1
	select MSM_PROC_COMM

config ARCH_QSD8X50
	bool "QSD8X50"
	select MACH_QSD8X50_SURF if !MACH_QSD8X50A_ST1_5
	select ARCH_MSM_SCORPION
	select MSM_SMD
	select MSM_VIC
	select CPU_V7
	select MSM_GPIOMUX
	select GPIO_MSM_V1
	select MSM_PROC_COMM

config ARCH_MSM8X60
	bool "MSM8X60"
	select MACH_MSM8X60_SURF if (!MACH_MSM8X60_RUMI3 && !MACH_MSM8X60_SIM \
				  && !MACH_MSM8X60_FFA)
	select ARCH_MSM_SCORPIONMP
	select ARM_GIC
	select CPU_V7
	select MSM_V2_TLMM
	select GPIO_MSM_V2
	select MSM_GPIOMUX
	select MSM_SCM if SMP

config ARCH_MSM8960
	bool "MSM8960"
	select ARCH_MSM_SCORPIONMP
	select MACH_MSM8960_SIM if (!MACH_MSM8960_RUMI3)
	select ARM_GIC
	select CPU_V7
	select MSM_V2_TLMM
	select MSM_GPIOMUX
	select MSM_SCM if SMP

config ARCH_IPQ806X
	bool "IPQ806X"
	select MSM_SMP
	select MSM_BUS_SCALING
	select ARCH_MSM_KRAIT
	select HAVE_SCHED_CLOCK
	select MACH_IPQ806X_RB3011
	select MSM7X00A_USE_GP_TIMER
	select LEDS_GPIO_REGISTER
	select HAVE_CLK_PREPARE
	select SWP_EMULATE
	select ARM_GIC
	select CPU_V7
	select PM
	select PCI
	select MSM_SMD
	select MSM_SMD_PKG4
	select PCI_MSI
	select MSM_PCIE
	select MSM_ADM3
	select MSM_SPM_V2
	select MSM_V2_TLMM
	select MSM_GPIOMUX
	select MSM_RPM
	select USB_EHCI_MSM
	select MSM_SCM if SMP
	select HAVE_SMP
	select SMP

endchoice

config MSM_HAS_DEBUG_UART_HS
	bool

config MSM_SOC_REV_A
	bool
config  ARCH_MSM_SCORPIONMP
	bool

config  ARCH_MSM_ARM11
	bool
config  ARCH_MSM_SCORPION
	bool

config  MSM_VIC
	bool

menu "Qualcomm MSM Board Type"

config MACH_HALIBUT
	depends on ARCH_MSM
	depends on ARCH_MSM7X00A
	bool "Halibut Board (QCT SURF7201A)"
	help
	  Support for the Qualcomm SURF7201A eval board.

config MACH_TROUT
	depends on ARCH_MSM
	depends on ARCH_MSM7X00A
	bool "HTC Dream (aka trout)"
	help
	  Support for the HTC Dream, T-Mobile G1, Android ADP1 devices.

config MACH_MSM7X30_SURF
	depends on ARCH_MSM7X30
	bool "MSM7x30 SURF"
	help
	  Support for the Qualcomm MSM7x30 SURF eval board.

config MACH_QSD8X50_SURF
	depends on ARCH_QSD8X50
	bool "QSD8x50 SURF"
	help
	  Support for the Qualcomm QSD8x50 SURF eval board.

config MACH_QSD8X50A_ST1_5
	depends on ARCH_QSD8X50
	select MSM_SOC_REV_A
	bool "QSD8x50A ST1.5"
	help
	  Support for the Qualcomm ST1.5.

config MACH_MSM8X60_RUMI3
	depends on ARCH_MSM8X60
	bool "MSM8x60 RUMI3"
	help
	  Support for the Qualcomm MSM8x60 RUMI3 emulator.

config MACH_MSM8X60_SURF
	depends on ARCH_MSM8X60
	bool "MSM8x60 SURF"
	help
	  Support for the Qualcomm MSM8x60 SURF eval board.

config MACH_MSM8X60_SIM
	depends on ARCH_MSM8X60
	bool "MSM8x60 Simulator"
	help
	  Support for the Qualcomm MSM8x60 simulator.

config MACH_MSM8X60_FFA
	depends on ARCH_MSM8X60
	bool "MSM8x60 FFA"
	help
	  Support for the Qualcomm MSM8x60 FFA eval board.

config MACH_MSM8960_SIM
	depends on ARCH_MSM8960
	bool "MSM8960 Simulator"
	help
	  Support for the Qualcomm MSM8960 simulator.

config MACH_MSM8960_RUMI3
	depends on ARCH_MSM8960
	bool "MSM8960 RUMI3"
	help
	  Support for the Qualcomm MSM8960 RUMI3 emulator.

config MACH_IPQ806X_RB3011
	depends on ARCH_IPQ806X
	bool "IPQ806X RB3011"
	help
	  Support for the Mikrotik IPQ806X RB3011 device.

config MSM_SPM_V2
	bool "Driver support for SPM Version 2"
	help
	  Enables the support for Version 2 of the SPM driver. SPM hardware is
	  used to manage the processor power during sleep. The driver allows
	  configuring SPM to allow different power modes.

config MSM_PCIE
	bool "MSM PCIe Controller driver"
	depends on PCI && PCI_MSI
	help
	  Enables the PCIe functionality by configures PCIe core on
	  MSM chipset and by enabling the ARM PCI framework extension.

config MSM_RPM
	bool "Resource Power Manager"
	select MSM_MPM

config MSM_BUS_SCALING
	bool "Bus scaling driver"
	default n

config MSM_NUM_PCIE
	int "Number of PCIe Root Complex"
	default 0 if !MSM_PCIE
	default 3 if ARCH_IPQ806X
	default 1
	range 0 3
	help
	  Max. number of PCIe RCs available in the SoC

config CPU_FREQ_MSM
        bool
        depends on CPU_FREQ && ARCH_MSM
        default y
        help
          This enables the CPUFreq driver for Qualcomm CPUs.
          If in doubt, say Y.

config MSM_N_WAY_SMSM
	depends on (MSM_SMD && !(ARCH_MSM7X01A))
	default y
	bool "MSM N-WAY SMSM support"
	help
	  Supports APPS-QDSP SMSM communication along with
	  normal APPS-MODEM SMSM communication.

endmenu

config MSM7X00A_USE_GP_TIMER
	bool

config MSM_MPM
	bool

config MSM_SMD_PKG4
	bool

config MSM_SMD_PKG3
	bool

config MSM_PROC_COMM
	bool

config MSM_SMD
	bool

config MSM_GPIOMUX
	bool

config MSM_V2_TLMM
	bool

config MSM_ADM3
	bool

config MSM_SCM
	bool

config ARCH_MSM_KRAIT
	bool

config MSM_SMP
	bool

endif
```
